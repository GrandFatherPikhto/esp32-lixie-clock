## main/Kconfig.projbuild
```kconfig
menu "Clock Configuration"

    config LED_GPIO
        int "GPIO number for LED strip (default)"
        default 14
        range 0 39
        help
            GPIO pin connected to the DIN of the LED strip. This is only the
            default: the value can be changed at runtime via the serial console
            (set gpio=<n>; save; reboot).

    config NUM_DIGITS
        int "Number of digit displays (default)"
        default 6
        range 1 8
        help
            Active number of 10-LED digit displays at startup. Usually 4 (HH:MM)
            or 6 (HH:MM:SS). Can be changed at runtime via the serial console.

    config NUM_DIGITS_MAX
        int "Maximum number of digit displays (buffer size)"
        default 6
        range 1 8
        help
            Compile-time upper bound for the pixel buffer. The runtime digit
            count is clamped to this value. Must be >= NUM_DIGITS.

    config SNTP_TIME_SERVER
        string "SNTP server name (default)"
        default "pool.ntp.org"
        help
            Default hostname of the SNTP server. Can be changed at runtime via
            the serial console (set ntp_server=<host>).

    choice SNTP_TIME_SYNC_METHOD
        prompt "Time synchronization method (default)"
        default SNTP_TIME_SYNC_METHOD_IMMED
        help
            Default time synchronization method (overridable at runtime).

        config SNTP_TIME_SYNC_METHOD_IMMED
            bool "update time immediately when received"
        config SNTP_TIME_SYNC_METHOD_SMOOTH
            bool "update time with smooth method (adjtime)"
        config SNTP_TIME_SYNC_METHOD_CUSTOM
            bool "custom implementation (not used)"
    endchoice

    config SNTP_SYNC_INTERVAL_PERIOD
        int "Time synchronization period (seconds, default)"
        default 3600
        range 30 604800
        help
            Default SNTP synchronization period in seconds. Can be changed at
            runtime via the serial console (set sync_interval=<sec>).

    config TIMEZONE_OFFSET_MINUTES
        int "Timezone offset (minutes from UTC, default)"
        default 180
        range -840 840
        help
            Default UTC offset in minutes, e.g. 180 = UTC+3 (Moscow),
            0 = UTC, -300 = UTC-5 (New York). Can be changed at runtime via the
            serial console (set tz_offset=<minutes>).

    config CLOCK_BRIGHTNESS_DEFAULT
        int "Default LED brightness (percent)"
        default 100
        range 0 100
        help
            Default display brightness in percent. Can be changed at runtime via
            the serial console (set brightness=<0..100>).

    config COLOR_MODE_DEFAULT
        int "Default color mode (0=rotate, 1=fixed)"
        default 0
        range 0 1
        help
            Default color mode: 0 = smooth HSV rotation, 1 = fixed hue.
            Can be changed at runtime via the serial console.

    config COLOR_HUE_DEFAULT
        int "Default fixed hue (0-359)"
        default 200
        range 0 359
        help
            Default hue used in fixed color mode. Can be changed at runtime via
            the serial console (set hue=<0..359>).

    config HUE_SHIFT_DEFAULT
        int "Default global hue shift (0-359)"
        default 0
        range 0 359
        help
            Base-hue offset applied to every palette. 0 keeps the current look.
            Can be changed at runtime via the serial console
            (set hue_shift=<0..359>).

    config HUE_2_DEFAULT
        int "Default secondary hue (0-359)"
        default 200
        range 0 359
        help
            Secondary hue used by Mono for alternate digits (two-tone) when it
            differs from `hue`. Can be changed at runtime via the serial
            console (set hue_2=<0..359>).

    config NIGHT_MODE_DEFAULT
        bool "Night mode enabled by default"
        default n
        help
            Master switch for automatic night-time brightness reduction.
            Can be changed at runtime via the serial console
            (set night_mode=<0|1>).

    config NIGHT_LOW_BRIGHTNESS_DEFAULT
        int "Default night brightness (percent)"
        default 5
        range 0 100
        help
            Brightness used during night hours. Can be changed at runtime via
            the serial console (set night_low_brightness=<0..100>).

    config NIGHT_START_HOUR_DEFAULT
        int "Night window start hour (default)"
        default 23
        range 0 23
        help
            Start hour of the night window (inclusive). Can be changed at
            runtime via the serial console (set night_start=<0..23>).

    config NIGHT_END_HOUR_DEFAULT
        int "Night window end hour (default)"
        default 7
        range 0 23
        help
            End hour of the night window (exclusive; wraps across midnight).
            Can be changed at runtime via the serial console
            (set night_end=<0..23>).

    config CROSS_FADE_DEFAULT
        int "Cross-fade duration (milliseconds, default)"
        default 150
        range 0 2000
        help
            Fade duration for digit changes in milliseconds; 0 disables the
            effect (instant switching). Can be changed at runtime via the
            serial console (set cross_fade=<0..2000>).

    config SLOT_MACHINE_INTERVAL_DEFAULT
        int "Slot machine roll interval (minutes, default)"
        default 30
        range 0 1440
        help
            Period between automatic 0..9 "slot machine" rolls. 0 disables the
            effect. Can be changed at runtime via the serial console
            (set slot_machine_interval=<0..1440>).

    config WIFI_POWER_SAVE_DEFAULT
        bool "Wi-Fi radio off after time sync by default"
        default n
        help
            When enabled, the Wi-Fi radio is switched off after the first time
            sync and only woken periodically (per sync_interval) to re-sync.
            The display keeps running; lower RF/power at the cost of a
            reconnect on every resync. Can be changed at runtime via the serial
            console (set wifi_power_save=<0|1>).

endmenu
```
